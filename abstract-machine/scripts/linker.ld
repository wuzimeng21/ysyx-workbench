# ============================================================
# 链接脚本 (Linker Script) 详解
# ============================================================
# 文件名: 通常为 link.ld 或 linker.ld
# 作用: 告诉链接器如何将多个目标文件 (.o) 合并成一个可执行文件
# 语法: GNU ld 链接脚本语法
# ============================================================


# ============================================================
# 1. ENTRY 指令 - 设置程序入口点
# ============================================================

# ENTRY(symbol)
# 作用: 指定可执行文件的入口点（程序开始执行的第一条指令地址）
# 说明:
#   - 如果未指定，链接器会尝试查找 start, _start, main 等符号
#   - 这里指定 _start 为入口点
#   - _start 通常在 crt0 (C runtime) 或启动代码中定义
ENTRY(_start)


# ============================================================
# 2. PHDRS 指令 - 定义程序段 (Program Headers)
# ============================================================

# PHDRS { name type [ FILEHDR ] [ PHDRS ] [ AT ( address ) ] ... }
# 作用: 定义自定义的程序头表项，用于控制段到内存的映射
# 格式: 名称 类型 [属性]
#
# text PT_LOAD - 定义名为 "text" 的 PT_LOAD 段（代码段）
# data PT_LOAD - 定义名为 "data" 的 PT_LOAD 段（数据段）
PHDRS {
    text PT_LOAD;    # 代码段：可读可执行，通常只读
    data PT_LOAD;    # 数据段：可读可写
}


# ============================================================
# 3. SECTIONS 指令 - 定义输出文件的节布局
# ============================================================

SECTIONS {
    
    # --------------------------------------------------------
    # 3.1 设置当前地址 (Location Counter)
    # --------------------------------------------------------
    # . 是链接脚本中的位置计数器 (Location Counter)
    # 表示当前正在分配的虚拟地址
    # _pmem_start 和 _entry_offset 在 LDFLAGS 中定义
    # 例如: -Ttext=0x80000000 或 -T _pmem_start=0x80000000
    # 
    # 常见值:
    #   - x86: 0x1000 (传统) 或 0x8048000 (Linux)
    #   - RISC-V: 0x80000000 (QEMU 默认)
    #   - MIPS: 0x80000000 (内核空间) 或 0x40000000 (用户空间)
    . = _pmem_start + _entry_offset;
    
    # --------------------------------------------------------
    # 3.2 .text 节 (代码段)
    # --------------------------------------------------------
    # .text : { ... } : text
    #   - 第一个 text 是输出节名 (.text)
    #   - { ... } 中的内容是输入节
    #   - : text 表示将这个节放入名为 "text" 的程序段 (PHDRS 中定义)
    .text : {
        # entry 是一个特殊输入节，通常包含启动代码
        # 确保 _start 代码位于最前面
        *(entry)
        
        # 所有输入目标文件的 .text* 节 (.text, .text.*)
        # 匹配所有以 .text 开头的节名
        *(.text*)
        
        # 可选: 如果需要在代码段中放置只读数据
        # *(.rodata*)
    } : text
    
    # --------------------------------------------------------
    # 3.3 定义符号 etext 和 _etext (代码段结束位置)
    # --------------------------------------------------------
    # etext 和 _etext 是传统名称，表示 text 段的结束地址
    # 这些符号可以在 C 代码中通过 extern 声明使用
    # 例如: extern char etext[];  // 获取代码段结束地址
    etext = .;
    _etext = .;
    
    # --------------------------------------------------------
    # 3.4 .rodata 节 (只读数据段)
    # --------------------------------------------------------
    # 注意: 这里没有指定 :data 或 :text
    # 这意味着它会被放入默认段，通常是 text 段
    # 因为只读数据通常放在代码段中（节省内存，且可共享）
    .rodata : {
        *(.rodata*)      # 所有只读数据 (.rodata, .rodata.*)
    }
    
    # --------------------------------------------------------
    # 3.5 .data 节 (已初始化数据段)
    # --------------------------------------------------------
    # : data 表示将这个节放入名为 "data" 的程序段
    .data : {
        *(.data)         # 所有已初始化的全局变量
        # *(.data*)      # 如果有 .data.* 的节也可以加上
    } : data
    
    # --------------------------------------------------------
    # 3.6 定义符号 edata 和 _data (数据段结束位置)
    # --------------------------------------------------------
    edata = .;
    _data = .;
    
    # --------------------------------------------------------
    # 3.7 .bss 节 (未初始化数据段)
    # --------------------------------------------------------
    # .bss 节不占用文件空间，但在内存中占用空间
    # 加载器需要将这部分内存清零
    .bss : {
        _bss_start = .;          # 定义 BSS 段开始符号
        *(.bss*)                 # 所有未初始化的全局变量
        *(.sbss*)                # 小型未初始化数据（MIPS/RISC-V 优化）
        *(.scommon)              # 小型公共块
    }
    
    # --------------------------------------------------------
    # 3.8 栈区域设置
    # --------------------------------------------------------
    # ALIGN(0x1000) - 按 4KB (页大小) 对齐
    # 确保栈从页边界开始
    _stack_top = ALIGN(0x1000);
    
    # 栈向下增长 (从高地址向低地址)
    # 分配 0x8000 (32KB) 的栈空间
    . = _stack_top + 0x8000;
    
    # _stack_pointer 指向栈顶 (初始栈指针)
    # 注意: 栈通常从高地址向低地址增长
    # 所以初始栈指针指向分配区域的最高地址
    _stack_pointer = .;
    
    # --------------------------------------------------------
    # 3.9 堆区域设置
    # --------------------------------------------------------
    # end 和 _end 是传统名称，表示 BSS 段结束
    # 也是堆区的开始
    end = .;
    _end = .;
    
    # 堆起始地址，按页对齐
    _heap_start = ALIGN(0x1000);
    
    # 注意: 堆的结束地址没有定义
    # 在运行时通过 sbrk/brk 系统调用动态扩展
}


# ============================================================
# 内存布局可视化
# ============================================================

# 最终生成的内存布局:
#
# 低地址
#   +=============================+ <-- _pmem_start + _entry_offset
#   | .text (代码段)              |
#   |   - 启动代码 (entry)        |
#   |   - 所有函数代码            |
#   |   - 可能包含 .rodata        |
#   +-----------------------------+ <-- etext / _etext
#   | .rodata (只读数据)          |
#   |   - 字符串常量              |
#   |   - 只读全局变量            |
#   +-----------------------------+ <-- _data / edata (data 开始)
#   | .data (已初始化数据)        |
#   |   - 已初始化的全局变量      |
#   +-----------------------------+ <-- _bss_start
#   | .bss (未初始化数据)         |
#   |   - 未初始化的全局变量      |
#   |   - 运行时清零               |
#   +-----------------------------+ <-- end / _end
#   |                             |
#   |      (空闲区域 - 堆)         |
#   |                             |
#   +-----------------------------+ <-- _heap_start (堆起始)
#   |                             |
#   |          堆区                |
#   |      (动态分配)              |
#   |                             |
#   +-----------------------------+
#   |          栈区                |
#   |      (向下增长)              |
#   +-----------------------------+ <-- _stack_pointer (初始栈顶)
#   | (对齐填充)                   |
#   +-----------------------------+ <-- _stack_top
# 高地址


# ============================================================
# 符号表 (可在 C 代码中访问)
# ============================================================

# 这些符号由链接器定义，可以在 C 代码中通过 extern 声明使用:

/*
 * 代码段边界
 */
extern char etext[];
extern char _etext[];

/*
 * 数据段边界
 */
extern char edata[];
extern char _data[];

/*
 * BSS 段边界 (堆区开始)
 */
extern char end[];
extern char _end[];
extern char _bss_start[];

/*
 * 栈区域
 */
extern char _stack_top[];
extern char _stack_pointer[];

/*
 * 堆起始地址
 */
extern char _heap_start[];

/*
 * 使用示例:
 * 
 * // 获取各个段的大小
 * size_t text_size = _etext - (char *)0x80000000;
 * size_t data_size = _data - _etext;
 * size_t bss_size = _end - _bss_start;
 * 
 * // 初始化 BSS 段 (清零)
 * for (char *p = _bss_start; p < _end; p++) {
 *     *p = 0;
 * }
 * 
 * // 获取栈顶指针 (用于设置 sp 寄存器)
 * asm volatile("mv sp, %0" : : "r"(_stack_pointer));
 * 
 * // 获取堆起始地址 (用于 sbrk 初始化)
 * void *heap_start = _heap_start;
 * void *program_break = _heap_start;
 */


# ============================================================
# 编译命令示例
# ============================================================

# 1. 编译目标文件
#    riscv64-unknown-elf-gcc -c -o program.o program.c

# 2. 链接，使用自定义链接脚本
#    riscv64-unknown-elf-ld -T link.ld \
#        -Ttext=0x80000000 \
#        -o program \
#        crt0.o program.o

# 3. 或者在编译时指定链接脚本
#    riscv64-unknown-elf-gcc -T link.ld \
#        -Wl,-Ttext=0x80000000 \
#        -o program \
#        program.c


# ============================================================
# 常见链接器符号
# ============================================================

# 符号名    | 作用
# ----------|----------------------------------------------
# _start    | 程序入口点，由 crt0 或启动代码提供
# etext     | .text 段结束地址
# edata     | .data 段结束地址
# end       | .bss 段结束地址（堆开始）
# _stack_top| 栈区域顶部（栈底）
# _stack_pointer | 初始栈指针（栈顶）
# _heap_start| 堆起始地址


# ============================================================
# 注意事项
# ============================================================

# 1. 位置计数器 (.)
#    - 代表当前输出地址
#    - 可以在链接脚本中赋值
#    - 使用 += 或 = 来移动

# 2. 输入节通配符
#    *(.text*) - 匹配所有以 .text 开头的节
#    *(.data)  - 只匹配 .data 节

# 3. 程序段 (PHDRS)
#    - 必须在 SECTIONS 之前定义
#    - 每个输出节可以通过 :name 指定放入哪个程序段
#    - 加载器根据程序段决定如何加载内存

# 4. 对齐 (ALIGN)
#    ALIGN(0x1000) - 按 4KB 对齐（页大小）
#    确保内存区域在页边界开始，方便 MMU 管理

# 5. 栈设置
#    栈通常从高地址向低地址增长
#    _stack_pointer 应该指向栈区域的最高地址
#    例如: 分配 32KB 栈，sp 指向栈顶